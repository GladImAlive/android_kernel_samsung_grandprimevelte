/*
 *	Copyright (C) 2014 Marvell Technology Group Ltd.
 *	Copyright (C) 2014 Samsung Electronics Co, Ltd.
 *
 *	This program is free software; you can redistribute it and/or modify
 *	it under the terms of the GNU General Public License version 2 as
 *	published by the Free Software Foundation.
 */

/dts-v1/;

#include "sec-machtypes.h"

/ {
	model = "PXA1908";
	compatible = "sec,grandprimevelte-02", "marvell,pxa1908";
	pxa,rev-id = <MACH_TYPE_GRANDPRIMEVELTE 2>;

	fragment@0 {
		target-path = "/";
		__overlay__ {
			reserved-memory {
				#address-cells = <1>;
				#size-cells = <1>;
				ranges;

				ramoops: ramoops@0b000000 {
					compatible = "ramoops";
					reg = <0x0b000000 0x10000>; /* 64kB */
					record-size = <0x4000>; /* 16kB */
					console-size = <0>; /* disabled by default */
				};
			};
		};
	};

	__overrides__ {
		total-size = <&ramoops>,"reg:4";
		record-size = <&ramoops>,"record-size:0";
		console-size = <&ramoops>,"console-size:0";
	};
};
